## board/freescale/imx8mm_columbia/Kconfig
```kconfig
if TARGET_IMX8MM_COLUMBIA

config SYS_BOARD
	default "imx8mm_columbia"

config SYS_VENDOR
	default "freescale"

config SYS_CONFIG_NAME
	default "imx8mm_columbia"

source "board/freescale/common/Kconfig"

endif
```
